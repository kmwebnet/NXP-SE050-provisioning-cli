#include <string.h>
#include <stdio.h>
#include <stdlib.h>
#include "driver/gpio.h"
#include "driver/i2c.h"
#include "driver/uart.h"
#include "soc/uart_struct.h"
#include "esp_err.h"
#include "esp_log.h"
#include "freertos/FreeRTOS.h"
#include "freertos/task.h"
#include "freertos/event_groups.h"
#include "esp_wifi.h"
#include "esp_event_loop.h"
#include "esp_system.h"
#include "nvs_flash.h"

#include "lwip/err.h"
#include "lwip/sockets.h"
#include "lwip/sys.h"
#include "lwip/netdb.h"
#include "lwip/dns.h"

#include "provision.h"

#include "sdkconfig.h" // generated by "make menuconfig"

#include "mbedtls/esp_config.h"
#define MBEDTLS_CONFIG_FILE "mbedtls/esp_config.h"


#define SDA2_PIN GPIO_NUM_18
#define SCL2_PIN GPIO_NUM_19

#define TAG "maintask"

#define I2C_MASTER_ACK 0
#define I2C_MASTER_NACK 1

#define EX_UART_NUM UART_NUM_0
#define PATTERN_CHR_NUM    (3) 

#define BUF_SIZE (2048)
#define RD_BUF_SIZE (BUF_SIZE)
static QueueHandle_t uart0_queue;

const char certificatefooter[] = "----END CERTIFICATE----";

uint8_t stateflag = 0;
uint16_t certificateoffset = 0;

char rootcert[1000] = {};
char signercert[1000] = {};
char devicecert[1000] = {};
char uid[300] = {};

/* clang-format off */

#if defined(SSS_USE_FTR_FILE)
#include "fsl_sss_ftr.h"
#else
#include "fsl_sss_ftr_default.h"
#endif

#define mbedtls_time time
#define mbedtls_time_t time_t
#define mbedtls_printf printf
#define mbedtls_fprintf fprintf
#define mbedtls_snprintf snprintf

#include <assert.h>


#include "mbedtls/net_sockets.h"
#include "mbedtls/ssl.h"
#include "mbedtls/entropy.h"
#include "mbedtls/ctr_drbg.h"
#include "mbedtls/certs.h"
#include "mbedtls/x509.h"
#include "mbedtls/error.h"
#include "mbedtls/debug.h"
#include "mbedtls/timing.h"

/* +S */

#ifdef TGT_A71CH
#   include "sm_printf.h"
#endif

#if SSS_HAVE_ALT_SSS
#include "sss_mbedtls.h"
#endif

#include <ex_sss.h>
#include <ex_sss_boot.h>
#include <nxLog_App.h>
#include <se05x_APDU.h>

static ex_sss_boot_ctx_t gex_sss_demo_boot_ctx;
ex_sss_boot_ctx_t *pex_sss_demo_boot_ctx = &gex_sss_demo_boot_ctx;
static ex_sss_cloud_ctx_t gex_sss_demo_tls_ctx;
ex_sss_cloud_ctx_t *pex_sss_demo_tls_ctx = &gex_sss_demo_tls_ctx;

#define EX_SSS_BOOT_PCONTEXT (&gex_sss_demo_boot_ctx)

#define EX_SSS_BOOT_DO_ERASE 0
#define EX_SSS_BOOT_EXPOSE_ARGC_ARGV 1

#include <ex_sss_main_inc.h>

#include "ex_sss_objid.h"

#define OBJID_usr_key (EX_SSS_OBJID_CUST_START + 0x10000002u)
#define OBJID_usr_cert (EX_SSS_OBJID_CUST_START + 0x10000003u)
#define OBJID_signer_cert (EX_SSS_OBJID_CUST_START + 0x10000004u)
#define OBJID_root_cert (EX_SSS_OBJID_CUST_START + 0x10000005u)

void i2c_master_init()
{
	i2c_config_t i2c_config = {
		.mode = I2C_MODE_MASTER,
		.sda_io_num = SDA2_PIN,
		.scl_io_num = SCL2_PIN,
		.sda_pullup_en = GPIO_PULLUP_DISABLE,
		.scl_pullup_en = GPIO_PULLUP_DISABLE,
		.master.clk_speed = 100000
		};
			
	i2c_param_config(I2C_NUM_0 , &i2c_config);
	i2c_driver_install(I2C_NUM_0 , I2C_MODE_MASTER, 0, 0, 0);


}

static void uart_event_task(void *pvParameters)
{
    uart_event_t event;
    size_t buffered_size;
    uint8_t* dtmp = (uint8_t*) malloc(RD_BUF_SIZE);
    for(;;) {
        //Waiting for UART event.
        if(xQueueReceive(uart0_queue, (void * )&event, (portTickType)portMAX_DELAY)) {
            bzero(dtmp, RD_BUF_SIZE);
            switch(event.type) {
                //Event of UART receving data
                /*We'd better handler data event fast, there would be much more data events than
                other types of events. If we take too much time on data event, the queue might
                be full.*/
                case UART_DATA:
                    uart_read_bytes(EX_UART_NUM, dtmp, event.size, portMAX_DELAY);

                    if(stateflag == 1){
                        memcpy (&signercert[certificateoffset], dtmp, event.size);                       
                        certificateoffset += event.size;
                    // detect the end of certificate
                        if ( strstr ((char *)dtmp , certificatefooter) != NULL )
                            {
                                stateflag = 11;
                                certificateoffset = 0;

                                uart_flush(EX_UART_NUM);
                                break;
                            }
                    uart_flush(EX_UART_NUM);
                    break;
                    }

                    if(stateflag == 2){
                        memcpy (&devicecert[certificateoffset], dtmp, event.size);                       
                        certificateoffset += event.size;
                    // detect the end of certificate
                        if ( strstr ((char *)dtmp , certificatefooter) != NULL )
                            {
                                stateflag = 12;
                                certificateoffset = 0;

                                uart_flush(EX_UART_NUM);
                                break;
                            }
                    uart_flush(EX_UART_NUM);
                    break;
                    }

                    if(stateflag == 3){
                        memcpy (&rootcert[certificateoffset], dtmp, event.size);                       
                        certificateoffset += event.size;
                    // detect the end of certificate
                        if ( strstr ((char *)dtmp , certificatefooter) != NULL )
                            {
                                stateflag = 13;
                                certificateoffset = 0;

                                uart_flush(EX_UART_NUM);
                                break;
                            }
                    uart_flush(EX_UART_NUM);
                    break;
                    }
// communication check command
                    if('R' == dtmp[0]){
                    printf("Ready.\n");
                    uart_flush(EX_UART_NUM);
                    }
// public key output mode
                    if('k' == dtmp[0]){
                    stateflag = 6;
                    uart_flush(EX_UART_NUM);
                    }

// signer certificate accept mode
                    if('c' == dtmp[0]){
                    stateflag = 1;
                    printf("input signer cert PEM:\n");
                    uart_flush(EX_UART_NUM);
                    }

// device certificate accept mode
                    if('v' == dtmp[0]){
                    stateflag = 2;
                    printf("input device cert PEM:\n");
                    uart_flush(EX_UART_NUM);
                    }

// root certificate accept mode
                    if('r' == dtmp[0]){
                    stateflag = 3;
                    printf("input root cert PEM:\n");
                    uart_flush(EX_UART_NUM);
                    }
// serial number output mode
                    if('s' == dtmp[0]){
                    stateflag = 5;
                    uart_flush(EX_UART_NUM);
                    }


                    if('p' == dtmp[0]){
                    printf("Signer CA cert data:\n");
                    printf(signercert);
                    printf("\n");
                    fflush(stdout);

                    printf("device cert data:\n");
                    printf(devicecert);
                    printf("\n");
                    fflush(stdout);

                    printf("root CA cert data:\n");
                    printf(rootcert);
                    printf("\n");
                    fflush(stdout);
                    break;
                    }
// quit application
                    if('q' == dtmp[0]){
                        stateflag = 100;
                        free(dtmp);
                        dtmp = NULL;
                        uart_flush(EX_UART_NUM);
                        vTaskDelete(NULL);
                    }


                    break;
                //Event of HW FIFO overflow detected
                case UART_FIFO_OVF:
                    ESP_LOGI(TAG, "hw fifo overflow");
                    // If fifo overflow happened, you should consider adding flow control for your application.
                    // The ISR has already reset the rx FIFO,
                    // As an example, we directly flush the rx buffer here in order to read more data.
                    uart_flush_input(EX_UART_NUM);
                    xQueueReset(uart0_queue);
                    break;
                //Event of UART ring buffer full
                case UART_BUFFER_FULL:
                    ESP_LOGI(TAG, "ring buffer full");
                    // If buffer full happened, you should consider encreasing your buffer size
                    // As an example, we directly flush the rx buffer here in order to read more data.
                    uart_flush_input(EX_UART_NUM);
                    xQueueReset(uart0_queue);
                    break;
                //Event of UART RX break detected
                case UART_BREAK:
                    ESP_LOGI(TAG, "uart rx break");
                    break;
                //Event of UART parity check error
                case UART_PARITY_ERR:
                    ESP_LOGI(TAG, "uart parity error");
                    break;
                //Event of UART frame error
                case UART_FRAME_ERR:
                    ESP_LOGI(TAG, "uart frame error");
                    break;
                //UART_PATTERN_DET
                case UART_PATTERN_DET:
                    uart_get_buffered_data_len(EX_UART_NUM, &buffered_size);
                    int pos = uart_pattern_pop_pos(EX_UART_NUM);
                    ESP_LOGI(TAG, "[UART PATTERN DETECTED] pos: %d, buffered size: %d", pos, buffered_size);
                    if (pos == -1) {
                        // There used to be a UART_PATTERN_DET event, but the pattern position queue is full so that it can not
                        // record the position. We should set a larger queue size.
                        // As an example, we directly flush the rx buffer here.
                        uart_flush_input(EX_UART_NUM);
                    } else {
                        uart_read_bytes(EX_UART_NUM, dtmp, pos, 100 / portTICK_PERIOD_MS);
                        uint8_t pat[PATTERN_CHR_NUM + 1];
                        memset(pat, 0, sizeof(pat));
                        uart_read_bytes(EX_UART_NUM, pat, PATTERN_CHR_NUM, 100 / portTICK_PERIOD_MS);
                        ESP_LOGI(TAG, "read data: %s", dtmp);
                        ESP_LOGI(TAG, "read pat : %s", pat);
                    }
                    break;
                //Others
                default:
                    ESP_LOGI(TAG, "uart event type: %d", event.type);
                    break;
            }
        }
    }
    free(dtmp);
    dtmp = NULL;
    vTaskDelete(NULL);
}




sss_status_t ex_sss_entry(ex_sss_boot_ctx_t *pCtx)
{

	int i = 0;
    sss_status_t status;

    uart_config_t uart_config = {
       .baud_rate = 115200,
       .data_bits = UART_DATA_8_BITS,
       .parity = UART_PARITY_DISABLE,
       .stop_bits = UART_STOP_BITS_1,
       .flow_ctrl = UART_HW_FLOWCTRL_DISABLE,
       //.rx_flow_ctrl_thresh = 122,
       .rx_flow_ctrl_thresh = 0,
    };
    //Set UART parameters
    uart_param_config(EX_UART_NUM, &uart_config);
    //Set UART log level
    esp_log_level_set(TAG, ESP_LOG_INFO);
    //Install UART driver, and get the queue.
    uart_driver_install(EX_UART_NUM, BUF_SIZE * 2, BUF_SIZE * 2, 10, &uart0_queue, 0);

    //Set UART pins (using UART0 default pins ie no changes.)
    uart_set_pin(EX_UART_NUM, UART_PIN_NO_CHANGE, UART_PIN_NO_CHANGE, UART_PIN_NO_CHANGE, UART_PIN_NO_CHANGE);

    //Set uart pattern detect function.
    uart_enable_pattern_det_intr(EX_UART_NUM, '+', 3, 10000, 10, 10);
    //Reset the pattern queue length to record at most 20 pattern positions.
    uart_pattern_queue_reset(EX_UART_NUM, 20);
    //Create a task to handler UART event from ISR
    xTaskCreate(uart_event_task, "uart_event_task", 2048, NULL, 12, NULL);


    do {

vTaskDelay(100/portTICK_PERIOD_MS); 

    if (stateflag == 5) // "s" serial number extract command
    {
    readuid(pCtx, uid);
    printf(uid);
    fflush(stdout);
    stateflag = 0;
    }

    if (stateflag == 6) // "k" public key extract command
    {
    char pkeyresult[500];
    pkeyprovision((sss_object_t *)&pex_sss_demo_tls_ctx->obj, pCtx, OBJID_usr_key, pkeyresult);
    printf(pkeyresult);
    fflush(stdout);
    stateflag = 0;
    }

    if (stateflag == 11) // write signer CA cert command
    {

	i = 0;
	while(signercert[i] != '\0'){
        if (signercert[i] == '\r')
        {
            signercert[i] = '\n';
        }
		i++;
	}

    status = writepemcert((sss_object_t *)&pex_sss_demo_tls_ctx->interCaCert, pCtx, OBJID_signer_cert, (unsigned char *)signercert);
    if (status == kStatus_SSS_Success)
    {
        printf("signer CA cert registration on %08x success\n", OBJID_signer_cert);
    }
    else
    {
        printf("signer CA cert registration on %08x fail\n", OBJID_signer_cert);
    }
    fflush(stdout);
    stateflag = 0;
    }

    if (stateflag == 12) // write device cert command
    {
    
	i = 0;
	while(devicecert[i] != '\0'){
        if (devicecert[i] == '\r')
        {
            devicecert[i] = '\n';
        }
		i++;
	}

    status = writepemcert((sss_object_t *)&pex_sss_demo_tls_ctx->dev_cert, pCtx, OBJID_usr_cert, (unsigned char *)devicecert);
    if (status == kStatus_SSS_Success)
    {
        printf("device cert registration on 0x%08x success\n", OBJID_usr_cert);
    }
    else
    {
        printf("device cert registration on 0x%08x fail\n", OBJID_usr_cert);
    }
    fflush(stdout);
    stateflag = 0;
    }

    if (stateflag == 13) // write root CA cert command
    {

	i = 0;
	while(rootcert[i] != '\0'){
        if (rootcert[i] == '\r')
        {
            rootcert[i] = '\n';
        }
		i++;
	}

    status = writepemcert((sss_object_t *)&pex_sss_demo_tls_ctx->pub_obj, pCtx, OBJID_root_cert, (unsigned char *)rootcert);
    if (status == kStatus_SSS_Success)
    {
        printf("root CA cert registration on %08x success\n", OBJID_root_cert);
    }
    else
    {
        printf("root CA cert registration on %08x fail\n", OBJID_root_cert);
    }
    fflush(stdout);
    stateflag = 0;
    }

    if (stateflag == 100)
    {
    break;
    }
    
    } while(1);

    return kStatus_SSS_Success;
}



void app_main(void)
{
	i2c_master_init();
    ESP_ERROR_CHECK( nvs_flash_init() );    
    main( 1 ,NULL);
}